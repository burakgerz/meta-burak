## conf/distro/buraks-distro.conf
```bitbake
require conf/distro/poky.conf

DISTRO = "buraks-distro"
DISTRO_NAME = "burak raspi"

DISTRO_FEATURES_append = " systemd \
			   polkit "
DISTRO_FEATURES_remove = " alsa \
			   bluetooth \
			   x11 \
			   opengl \
			   wayland \
			   vulkan \
			   pulseaudio \
" 

DISTRO_FEATURES_BACKFILL_CONSIDERED += "sysvinit"

VIRTUAL-RUNTIME_init_manager = "systemd"
VIRTUAL-RUNTIME_initscripts = ""
```

## conf/layer.conf
```bitbake
# We have a conf and classes directory, add to BBPATH
BBPATH .= ":${LAYERDIR}"

# We have recipes-* directories, add to BBFILES
BBFILES += "${LAYERDIR}/recipes-*/*/*.bb \
            ${LAYERDIR}/recipes-*/*/*.bbappend"

BBFILE_COLLECTIONS += "meta-burak"
BBFILE_PATTERN_meta-burak = "^${LAYERDIR}/"
BBFILE_PRIORITY_meta-burak = "10"

LAYERDEPENDS_meta-burak = "core"
LAYERSERIES_COMPAT_meta-burak = "honister hardknott"
```

## conf/machine/raspberrypi3-64-burak.conf
```bitbake
require conf/machine/raspberrypi3-64.conf

MACHINE = "raspberrypi3-64"

BOOT_SPACE = "81920"

# Use u-boot
RPI_USE_U_BOOT = "1"
PREFERRED_PROVIDER_virtual/bootloader = "u-boot"

# Enable UART. This will add conosle=serial0,115200 to kernel command line
ENABLE_UART = "1"
```
